# M55M1 register map
File version: 1.0
M55M1 SVD file
Registers are 32-bit, read-write, reset 0x0 unless marked. A register's access mark holds for its fields unless they carry their own. Offsets are from the block's base; lines under a group give offsets from that group; [hi:lo] are bit positions; {n}, {i} and the like mark numbered series; 'fields as' and 'values as' point back to an identical list; <NAME> marks a mode.

## Memory map
0x04004000 GDMA blocks up to offset 0x1200 — GDMA Register Map
0x40000000 SYS blocks up to offset 0xE9C — SYS Register Map
0x40001000 CLK blocks up to offset 0x54C — CLK Register Map
0x40002000 PMC blocks up to offset 0x144 — PMC Register Map
0x40003000 NPU blocks up to offset 0x1000 — NPU Register Map
0x40040000 OTFC0 blocks up to offset 0x110 — OTFC Register Map
0x40042000 SPIM0 blocks up to offset 0xA8 — SPIM Register Map
0x40044000 FMC blocks up to offset 0x120 — FMC Register Map
0x40200000 PDMA0 blocks up to offset 0x490 — PDMA Register Map
0x40201000 PDMA1 blocks up to offset 0x490 — PDMA Register Map
0x40202000 USBH0 blocks up to offset 0x208 — USBH Register Map
0x40203000 USBH1 size 0x58 — HSUSBH Register Map
0x40204000 HSUSBH blocks up to offset 0x58 — HSUSBH Register Map
0x40205000 HSUSBD blocks up to offset 0x708 — USBD Register Map
0x40206000 SDH0 blocks up to offset 0x840 — SDH Register Map
0x40207000 SDH1 blocks up to offset 0x840 — SDH Register Map
0x40208000 EMAC0 blocks up to offset 0x105C — EMAC Register Map
0x4020A000 CRYPTO blocks up to offset 0xF94 — CRYPTO Register Map
0x4020B000 CRC blocks up to offset 0x50 — CRC Register Map
0x40220000 KS blocks up to offset 0xF4 — KS Register Map
0x40221000 KDF blocks up to offset 0xF0C — KDF Register Map
0x40222000 CANFD0 blocks up to offset 0xFC — CANFD Register Map
0x40224000 CANFD1 blocks up to offset 0xFC — CANFD Register Map
0x40229000 GPIO blocks up to offset 0xA78 — GPIO Register Map
0x40230000 EBI blocks up to offset 0x28 — EBI Register Map
0x40240000 WWDT0 size 0x10 — WWDT Register Map
0x40241000 EADC blocks up to offset 0x284 — EADC Register Map
0x40242000 EPWM0 blocks up to offset 0x380 — EPWM Register Map
0x40243000 BPWM0 blocks up to offset 0x334 — BPWM Register Map
0x40244000 EQEI0 blocks up to offset 0x30 — EQEI Register Map
0x40245000 EQEI1 blocks up to offset 0x30 — EQEI Register Map
0x40246000 ECAP0 size 0x20 — ECAP Register Map
0x40247000 ECAP2 size 0x20 — ECAP Register Map
0x40248000 I2C0 blocks up to offset 0x6C — I2C Register Map
0x40249000 I2C2 blocks up to offset 0x6C — I2C Register Map
0x4024A000 QSPI0 blocks up to offset 0x34 — QSPI Register Map
0x4024B000 SPI0 blocks up to offset 0x6C — SPI Register Map
0x4024C000 SPI2 blocks up to offset 0x6C — SPI Register Map
0x4024D000 UART0 size 0x50 — UART Register Map
0x4024E000 UART2 blocks up to offset 0x50 — UART Register Map
0x4024F000 UART4 blocks up to offset 0x50 — UART Register Map
0x40250000 UART6 blocks up to offset 0x50 — UART Register Map
0x40251000 UART8 blocks up to offset 0x50 — UART Register Map
0x40252000 UUART0 blocks up to offset 0x68 — USCIUART Register Map
0x40252000 USPI0 blocks up to offset 0x68 — USCISPI Register Map
0x40252000 UI2C0 blocks up to offset 0x90 — USCII2C Register Map
0x40253000 SC0 blocks up to offset 0x50 — SC Register Map
0x40253A00 SC2 blocks up to offset 0x50 — SC Register Map
0x40255000 PSIO blocks up to offset 0x13C — PSIO Register Map
0x40256000 TIMER01 blocks up to offset 0x1BC — TIMER Register Map
0x40257000 DAC blocks up to offset 0x58 — DAC Register Map
0x40259000 HSOTG size 0x14 — HSOTG Register Map
0x4025A000 I2S0 blocks up to offset 0x28 — I2S Register Map
0x4025B000 ACMP01 size 0x18 — ACMP Register Map
0x4025C000 USBD blocks up to offset 0x690 — USBD Register Map
0x40280000 WWDT1 size 0x10 — WWDT Register Map
0x40282000 EPWM1 blocks up to offset 0x380 — EPWM Register Map
0x40283000 BPWM1 blocks up to offset 0x334 — BPWM Register Map
0x40284000 EQEI2 blocks up to offset 0x30 — EQEI Register Map
0x40285000 EQEI3 blocks up to offset 0x30 — EQEI Register Map
0x40286000 ECAP1 size 0x20 — ECAP Register Map
0x40287000 ECAP3 size 0x20 — ECAP Register Map
0x40288000 I2C1 blocks up to offset 0x6C — I2C Register Map
0x40289000 I2C3 blocks up to offset 0x6C — I2C Register Map
0x4028A000 QSPI1 blocks up to offset 0x34 — QSPI Register Map
0x4028B000 SPI1 blocks up to offset 0x6C — SPI Register Map
0x4028C000 SPI3 blocks up to offset 0x6C — SPI Register Map
0x4028D000 UART1 size 0x50 — UART Register Map
0x4028E000 UART3 blocks up to offset 0x50 — UART Register Map
0x4028F000 UART5 blocks up to offset 0x50 — UART Register Map
0x40290000 UART7 blocks up to offset 0x50 — UART Register Map
0x40291000 UART9 blocks up to offset 0x50 — UART Register Map
0x40292000 SC1 blocks up to offset 0x50 — SC Register Map
0x40293000 OTG size 0x14 — OTG Register Map
0x40294000 KPI blocks up to offset 0x2C — KPI Register Map
0x40295000 TIMER23 blocks up to offset 0x1BC — TIMER Register Map
0x40296000 TRNG size 0x1C — TRNG Register Map
0x40297000 RTC blocks up to offset 0x148 — RTC Register Map
0x40298000 I2S1 blocks up to offset 0x28 — I2S Register Map
0x40299000 ACMP23 size 0x18 — ACMP Register Map
0x4029A000 I3Cn blocks up to offset 0x29C — I3C Register Map
0x4029B000 UTCPD blocks up to offset 0x33C — UTCPD Register Map
0x40400000 LPPDMA0 blocks up to offset 0x484 — LPPDMA Register Map
0x40401000 CCAP blocks up to offset 0x1C0 — CCAP Register Map
0x40402000 SCU blocks up to offset 0x450 — SCU Register Map
0x40402500 FVC blocks up to offset 0x28 — SCU Register Map
0x40402600 DPM blocks up to offset 0x70 — SCU Register Map
0x40402700 PLM size 0x8 — SCU Register Map
0x40403000 LPGPIO size 0x14 — LPGPIO Register Map
0x40440000 LPTMR01 blocks up to offset 0x1B8 — LPTMR Register Map
0x40441000 TTMR01 blocks up to offset 0x120 — TTMR Register Map
0x40442000 LPADC0 blocks up to offset 0x814 — LPADC Register Map
0x40443000 LPI2C0 blocks up to offset 0x7C — LPI2C Register Map
0x40444000 LPSPI blocks up to offset 0x58 — LPSPI Register Map
0x40445000 DMIC size 0x1C — DMIC Register Map
0x40445300 VAD size 0x28 — DMIC Register Map
0x40446000 LPUART0 blocks up to offset 0x60 — LPUART Register Map
0x40447000 WDT0 size 0x10 — WDT Register Map
0x40448000 WDT1 size 0x10 — WDT Register Map
0x40449000 AWF blocks up to offset 0x44 — AWF Register Map
0x50000000 SYS_NS blocks up to offset 0x104 — SYS Register Map
0x50001000 CLK_NS blocks up to offset 0x54C — CLK Register Map
0x50044000 FMC_NSBA blocks up to offset 0x120 — FMC Register Map
0x50200000 PDMA0_NS blocks up to offset 0x490 — PDMA Register Map
0x50201000 PDMA1_NS blocks up to offset 0x490 — PDMA Register Map
0x50202000 USBH0_NS blocks up to offset 0x208 — USBH Register Map
0x50208000 EMAC0_NS blocks up to offset 0x105C — EMAC Register Map
0x5020A000 CRYPTO_NS blocks up to offset 0xF94 — CRYPTO Register Map
0x5020B000 CRC_NS blocks up to offset 0x50 — CRC Register Map
0x50221000 KDF_NS blocks up to offset 0xF0C — KDF Register Map
0x50222000 CANFD0_NS blocks up to offset 0xFC — CANFD Register Map
0x50224000 CANFD1_NS blocks up to offset 0xFC — CANFD Register Map
0x50229000 GPIO_NS blocks up to offset 0xA78 — GPIO Register Map
0x50230000 EBI_NS blocks up to offset 0x28 — EBI Register Map
0x50240000 WWDT0_NS size 0x10 — WWDT Register Map
0x50241000 EADC_NS blocks up to offset 0x284 — EADC Register Map
0x50242000 EPWM0_NS blocks up to offset 0x380 — EPWM Register Map
0x50243000 BPWM0_NS blocks up to offset 0x334 — BPWM Register Map
0x50244000 EQEI0_NS blocks up to offset 0x30 — EQEI Register Map
0x50245000 EQEI1_NS blocks up to offset 0x30 — EQEI Register Map
0x50246000 ECAP0_NS size 0x20 — ECAP Register Map
0x50247000 ECAP2_NS size 0x20 — ECAP Register Map
0x50248000 I2C0_NS blocks up to offset 0x6C — I2C Register Map
0x50249000 I2C2_NS blocks up to offset 0x6C — I2C Register Map
0x5024A000 QSPI0_NS blocks up to offset 0x34 — QSPI Register Map
0x5024B000 SPI0_NS blocks up to offset 0x6C — SPI Register Map
0x5024C000 SPI2_NS blocks up to offset 0x6C — SPI Register Map
0x5024D000 UART0_NS size 0x50 — UART Register Map
0x5024E000 UART2_NS blocks up to offset 0x50 — UART Register Map
0x5024F000 UART4_NS blocks up to offset 0x50 — UART Register Map
0x50250000 UART6_NS blocks up to offset 0x50 — UART Register Map
0x50251000 UART8_NS blocks up to offset 0x50 — UART Register Map
0x50252000 UUART0_NS blocks up to offset 0x68 — USCIUART Register Map
0x50252000 USPI0_NS blocks up to offset 0x68 — USCISPI Register Map
0x50252000 UI2C0_NS blocks up to offset 0x90 — USCII2C Register Map
0x50253000 SC0_NS blocks up to offset 0x50 — SC Register Map
0x50253A00 SC2_NS blocks up to offset 0x50 — SC Register Map
0x50256000 TIMER01_NS blocks up to offset 0x1BC — TIMER Register Map
0x50257000 DAC_NS blocks up to offset 0x58 — DAC Register Map
0x50259000 HSOTG_NS size 0x14 — HSOTG Register Map
0x5025A000 I2S0_NS blocks up to offset 0x28 — I2S Register Map
0x5025B000 ACMP01_NS size 0x18 — ACMP Register Map
0x5025C000 USBD_NS blocks up to offset 0x690 — USBD Register Map
0x50280000 WWDT1_NS size 0x10 — WWDT Register Map
0x50282000 EPWM1_NS blocks up to offset 0x380 — EPWM Register Map
0x50283000 BPWM1_NS blocks up to offset 0x334 — BPWM Register Map
0x50284000 EQEI2_NS blocks up to offset 0x30 — EQEI Register Map
0x50285000 EQEI3_NS blocks up to offset 0x30 — EQEI Register Map
0x50286000 ECAP1_NS size 0x20 — ECAP Register Map
0x50287000 ECAP3_NS size 0x20 — ECAP Register Map
0x50288000 I2C1_NS blocks up to offset 0x6C — I2C Register Map
0x50289000 I2C3_NS blocks up to offset 0x6C — I2C Register Map
0x5028A000 QSPI1_NS blocks up to offset 0x34 — QSPI Register Map
0x5028B000 SPI1_NS blocks up to offset 0x6C — SPI Register Map
0x5028C000 SPI3_NS blocks up to offset 0x6C — SPI Register Map
0x5028D000 UART1_NS size 0x50 — UART Register Map
0x5028E000 UART3_NS blocks up to offset 0x50 — UART Register Map
0x5028F000 UART5_NS blocks up to offset 0x50 — UART Register Map
0x50290000 UART7_NS blocks up to offset 0x50 — UART Register Map
0x50291000 UART9_NS blocks up to offset 0x50 — UART Register Map
0x50292000 SC1_NS blocks up to offset 0x50 — SC Register Map
0x50293000 OTG_NS size 0x14 — OTG Register Map
0x50294000 KPI_NS blocks up to offset 0x2C — KPI Register Map
0x50295000 TIMER23_NS blocks up to offset 0x1BC — TIMER Register Map
0x50296000 TRNG_NS size 0x1C — TRNG Register Map
0x50297000 RTC_NS blocks up to offset 0x148 — RTC Register Map
0x50298000 I2S1_NS blocks up to offset 0x28 — I2S Register Map
0x50299000 ACMP23_NS size 0x18 — ACMP Register Map
0x50400000 LPPDMA0_NS blocks up to offset 0x484 — LPPDMA Register Map
0x50402000 SCU_NS blocks up to offset 0x450 — SCU Register Map
0x50402600 DPM_NS blocks up to offset 0x70 — SCU Register Map
0x50403000 LPGPIO_NS size 0x14 — LPGPIO Register Map
0x50440000 LPTMR01_NS blocks up to offset 0x1B8 — LPTMR Register Map
0x50441000 TTMR01_NS blocks up to offset 0x120 — TTMR Register Map
0x50442000 LPADC0_NS blocks up to offset 0x814 — LPADC Register Map
0x50443000 LPI2C0_NS blocks up to offset 0x7C — LPI2C Register Map
0x50444000 LPSPI_NS blocks up to offset 0x58 — LPSPI Register Map
0x50445000 DMIC_NS size 0x1C — DMIC Register Map
0x50445300 VAD_NS size 0x28 — DMIC Register Map
0x50446000 LPUART0_NS blocks up to offset 0x60 — LPUART Register Map
0x50447000 WDT0_NS size 0x10 — WDT Register Map
0x50448000 WDT1_NS size 0x10 — WDT Register Map
0x50449000 AWF_NS blocks up to offset 0x44 — AWF Register Map
0xE000E000 SCS blocks up to offset 0xDE4 — SCR Register Map
